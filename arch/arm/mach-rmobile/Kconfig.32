## arch/arm/mach-rmobile/Kconfig.32
```kconfig
if RCAR_32

config R8A7740
	bool

config R8A7790
	bool

config R8A7791
	bool

config R8A7792
	bool

config R8A7793
	bool

config R8A7794
	bool

config SH73A0
	bool

choice
	prompt "Renesas ARM SoCs board select"
	optional

config TARGET_ARMADILLO_800EVA
	bool "armadillo 800 eva board"
	select R8A7740

config TARGET_BLANCHE
	bool "Blanche board"
	select R8A7792
	select DM
	select DM_SERIAL

config TARGET_GOSE
	bool "Gose board"
	select R8A7793
	select DM
	select DM_SERIAL

config TARGET_KOELSCH
	bool "Koelsch board"
	select R8A7791
	select DM
	select DM_SERIAL

config TARGET_LAGER
	bool "Lager board"
	select R8A7790
	select DM
	select DM_SERIAL

config TARGET_KZM9G
	bool "KZM9D board"
	select SH73A0

config TARGET_ALT
	bool "Alt board"
	select R8A7794
	select DM
	select DM_SERIAL

config TARGET_SILK
	bool "Silk board"
	select R8A7794
	select DM
	select DM_SERIAL

config TARGET_PORTER
	bool "Porter board"
	select R8A7791
	select DM
	select DM_SERIAL

config TARGET_STOUT
	bool "Stout board"
	select R8A7790
	select DM
	select DM_SERIAL

endchoice

config SYS_SOC
	default "rmobile"

config RMOBILE_EXTRAM_BOOT
	bool "Enable boot from RAM"
	depends on TARGET_ALT || TARGET_BLANCHE || TARGET_KOELSCH || TARGET_LAGER || TARGET_PORTER || TARGET_SILK || TARGET_STOUT
	default n

choice
	prompt "Qos setting primary"
	depends on TARGET_ALT || TARGET_BLANCHE || TARGET_GOSE || TARGET_KOELSCH || TARGET_LAGER
	default QOS_PRI_NORMAL

config QOS_PRI_NORMAL
	bool "Non primary"
	help
	   Select normal mode for QoS setting.

config QOS_PRI_MEDIA
	bool "Media primary"
	help
	   Select multimedia primary mode for QoS setting.

config QOS_PRI_GFX
	bool "GFX primary"
	help
	   Select GFX(graphics) primary mode for QoS setting.

endchoice

source "board/atmark-techno/armadillo-800eva/Kconfig"
source "board/renesas/blanche/Kconfig"
source "board/renesas/gose/Kconfig"
source "board/renesas/koelsch/Kconfig"
source "board/renesas/lager/Kconfig"
source "board/kmc/kzm9g/Kconfig"
source "board/renesas/alt/Kconfig"
source "board/renesas/silk/Kconfig"
source "board/renesas/porter/Kconfig"
source "board/renesas/stout/Kconfig"

endif
```

## board/kmc/kzm9g/Kconfig
```kconfig
if TARGET_KZM9G

config SYS_BOARD
	default "kzm9g"

config SYS_VENDOR
	default "kmc"

config SYS_CONFIG_NAME
	default "kzm9g"

config SYS_TEXT_BASE
	default 0x00000000

endif
```

## board/renesas/alt/Kconfig
```kconfig
if TARGET_ALT

config SYS_BOARD
	default "alt"

config SYS_VENDOR
	default "renesas"

config SYS_CONFIG_NAME
	default "alt"

config SYS_TEXT_BASE
	default 0x70000000 if RMOBILE_EXTRAM_BOOT
	default 0xE6304000

config R8A7794_ETHERNET_B
	bool "Use ethernet B function"
	depends on TARGET_ALT
	default n
	help
	  ALT board can use default ethernet and etnernet B function.
	  This config set pin function of ethenet B. You also needt to change
	  DIP switch of board in order to use this function.

endif
```

## board/renesas/blanche/Kconfig
```kconfig
if TARGET_BLANCHE

config SYS_BOARD
	default "blanche"

config SYS_VENDOR
	default "renesas"

config SYS_CONFIG_NAME
	default "blanche"

config SYS_TEXT_BASE
	default 0x00000000 if MTD_NOR_FLASH
	default 0x40000000

endif
```

## board/renesas/gose/Kconfig
```kconfig
if TARGET_GOSE

config SYS_BOARD
	default "gose"

config SYS_VENDOR
	default "renesas"

config SYS_CONFIG_NAME
	default "gose"

config SYS_TEXT_BASE
	default 0x70000000 if RMOBILE_EXTRAM_BOOT
	default 0xE6304000

endif
```

## board/renesas/koelsch/Kconfig
```kconfig
if TARGET_KOELSCH

config SYS_BOARD
	default "koelsch"

config SYS_VENDOR
	default "renesas"

config SYS_CONFIG_NAME
	default "koelsch"

config SYS_TEXT_BASE
	default 0x70000000 if RMOBILE_EXTRAM_BOOT
	default 0xE6304000

endif
```

## board/renesas/lager/Kconfig
```kconfig
if TARGET_LAGER

config SYS_BOARD
	default "lager"

config SYS_VENDOR
	default "renesas"

config SYS_CONFIG_NAME
	default "lager"

config SYS_TEXT_BASE
	default 0xB0000000 if RMOBILE_EXTRAM_BOOT
	default 0xE8080000

endif
```

## board/renesas/porter/Kconfig
```kconfig
if TARGET_PORTER

config SYS_BOARD
	default "porter"

config SYS_VENDOR
	default "renesas"

config SYS_CONFIG_NAME
	default "porter"

config SYS_TEXT_BASE
	default 0x70000000 if RMOBILE_EXTRAM_BOOT
	default 0xE6304000

endif
```

## board/renesas/silk/Kconfig
```kconfig
if TARGET_SILK

config SYS_BOARD
	default "silk"

config SYS_VENDOR
	default "renesas"

config SYS_CONFIG_NAME
	default "silk"

config SYS_TEXT_BASE
	default 0x70000000 if RMOBILE_EXTRAM_BOOT
	default 0xE6304000

endif
```

## board/renesas/stout/Kconfig
```kconfig
if TARGET_STOUT

config SYS_BOARD
	default "stout"

config SYS_VENDOR
	default "renesas"

config SYS_CONFIG_NAME
	default "stout"

config SYS_TEXT_BASE
	default 0xB0000000 if RMOBILE_EXTRAM_BOOT
	default 0xE8080000

endif
```
